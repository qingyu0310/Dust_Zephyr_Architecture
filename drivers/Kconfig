## drivers/Kconfig
```kconfig
# drivers/Kconfig - 底层硬件驱动抽象
# 提供 GPIO/PWM/UART/CAN 等外设驱动，以及 printk/shell 调试通道
# 每个 config 直接 select 对应的 Zephyr 子系统驱动符号

config DEV_GPIO
    default n
    bool "Enable simple GPIO device wrapper"
    select GPIO
    help
        Enable the lightweight GPIO wrappers in drivers/device/gpio.

config DEV_PWM
    default n
    bool "Enable simple PWM device wrapper"
    select PWM
    help
        Enable the lightweight PWM wrapper in drivers/device/pwm.

config COM_UART
    default n
    bool "UART interrupt driver"
    select SERIAL
    select UART_INTERRUPT_DRIVEN
    select UART_ASYNC_API
    help
        Enable the UART interrupt driver with ping-pong receive buffering.

config COM_UART_DMA
    default n
    bool "UART DMA driver"
    select SERIAL
    select UART_ASYNC_API
    help
        Enable the asynchronous DMA UART driver.

config COM_SPI
    default n
    bool "SPI driver"
    select SPI
    select GPIO
    help
        Enable the lightweight SPI wrapper in drivers/communication/spi.

config COM_CAN
    default n
    bool "CAN driver"
    select CAN
    help
        Enable the CAN driver. Board DTS must provide the CAN controller node.

config COM_RS485
    default n
    bool "RS485 half-duplex driver"
    select SERIAL
    select UART_ASYNC_API
    select GPIO
    help
        Enable the RS485 half-duplex driver using UART_ASYNC_API and a DE/RE GPIO.

config COM_CAN_STBY
    default n
    bool "Initialize CAN STBY pin"
    depends on COM_CAN
    select GPIO
    help
        Initialize the CAN transceiver STBY pin from board DTS overlay.
```

## modules/Kconfig
```kconfig
# modules/Kconfig - hardware-facing modules built on top of drivers/topics

config MOD_DEV_POWERMETER
    bool "Horizon power meter"
    default n
    select COM_CAN
    help
        Horizon power meter module.

config MOD_DEV_MOTOR_DJI
    bool "DJI motor"
    default n
    select COM_CAN
    help
        DJI motor module.

config MOD_DEV_MOTOR_DM
    bool "DM motor"
    default n
    select COM_CAN
    help
        DM motor module.

config MOD_DEV_REMOTE
    bool "Remote receiver"
    default n
    select COM_UART_DMA
    select TPC_REMOTE_TO
    help
        Remote receiver module.

config MOD_DEV_IMU
    bool "IMU module"
    default n
    select FLT_QUATERNION_EKF
    select TPC_IMU_TO
    select DEV_PWM
    select CTL_PID
    select CTL_TIMER
    help
        IMU source decoupling, attitude EKF and zbus publish layer.

config MOD_DEV_IMU_BMI088
    bool "BMI088 IMU source"
    default n
    depends on MOD_DEV_IMU
    select COM_SPI
    help
        BMI088 source implementation for the IMU module.

config MOD_DEV_IMU_ICM42688P
    bool "ICM42688P IMU source"
    default n
    depends on MOD_DEV_IMU
    select COM_SPI
    help
        ICM42688P source implementation for the IMU module.
```

## projects/thread/Kconfig
```kconfig
# Application thread and feature configuration.

rsource "../../drivers/Kconfig"
rsource "../../algorithm/Kconfig"
rsource "../../modules/Kconfig"
rsource "../../topic/Kconfig"

######################################################

config TRD_GPIO
    bool "GPIO thread task"
    default y
    select DEV_GPIO
    select CTL_TIMER
    help
      Enable the GPIO/output indicator thread.

######################################################

config TRD_CHASSIS
    bool "Chassis control thread"
    default n
    select MOD_CTL_POWER
    select MOD_DEV_MOTOR_DJI
    select TPC_TO_CAN_TX
    select TPC_REMOTE_TO
    help
      Enable chassis control thread.

config USE_POWERMETER
    bool "Power meter"
    depends on TRD_CHASSIS
    default n
    select MOD_DEV_POWERMETER
    help
      Enable power meter support for chassis control.

######################################################

config TRD_GIMBAL
    bool "Gimbal control thread"
    default n
    select CTL_PID
    select MOD_DEV_MOTOR_DM
    select TPC_TO_CAN_TX
    select TPC_REMOTE_TO
    help
      Enable gimbal control thread.

######################################################

config TRD_CAN_TX
    bool "CAN TX thread"
    default n
    select COM_CAN
    select TPC_TO_CAN_TX
    help
      Enable CAN TX thread.

######################################################

config TRD_REMOTE
    bool "Remote thread"
    default n
    select MOD_DEV_REMOTE
    help
      Enable remote receiver thread.

######################################################

config TRD_IMU
    bool "IMU thread"
    default n
    select MOD_DEV_IMU
    select TPC_IMU_TO
    help
      Enable IMU acquisition, heater control, and publish thread.

######################################################

config TRD_TFLM
    bool "TFLM inference thread"
    default n
    select TFLM
    help
      Enable TFLM inference test thread.

######################################################

config TRD_PC
    bool "PC communication thread"
    default y
    select COM_USB
    help
      PC communication thread (USB CDC ACM loopback test).

######################################################

config USER_TEST_ADD
    bool "User test add config"
    default n
    select COM_RS485
    help
      Temporary user test switch.

######################################################
```
