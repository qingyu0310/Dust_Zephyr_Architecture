## CMakeLists.txt
```
# SPDX-License-Identifier: Apache-2.0

cmake_minimum_required(VERSION 3.20.0)

# 项目选择 — 通过 Kconfig CONFIG_PRJ_TEST=y 控制 apps/ 和 threads/ 的加载
set(ACTIVE_PRJ "test" CACHE STRING "Active project")
set(PROJ_DIR project)
set(CONFIG_SYM PRJ_TEST)

# SDK glue 路径：HPMicro 板级/SOC/DTS 补丁
if(DEFINED ENV{SDK_GLUE_DIR})
  set(SDK_GLUE_DIR "$ENV{SDK_GLUE_DIR}")
else()
  set(SDK_GLUE_DIR "E:/Zephyr_HPMicro/sdk_glue")
endif()

# 注册额外 board/soc/dts 搜索路径
list(APPEND BOARD_ROOT "${SDK_GLUE_DIR}")
list(APPEND SOC_ROOT "${SDK_GLUE_DIR}")
list(APPEND DTS_ROOT "${SDK_GLUE_DIR}")
list(APPEND DTS_ROOT "${SDK_GLUE_DIR}/dts")

# 用户自研层 zephyr_user（与 zephyr 同级，独立 git 仓库）
set(ZEPHYR_USER_DIR "${CMAKE_CURRENT_SOURCE_DIR}/../../zephyr_user")
list(APPEND BOARD_ROOT "${ZEPHYR_USER_DIR}")
list(APPEND DTS_ROOT "${ZEPHYR_USER_DIR}")
list(APPEND DTS_ROOT "${ZEPHYR_USER_DIR}/dts")

# 用户自研层 sdk_glue_user（与 sdk_glue 同级，独立 git 仓库）
# 用 CMAKE_CURRENT_SOURCE_DIR 相对（不依赖 SDK_GLUE_DIR 环境变量的 D/E 状态）
set(SDK_GLUE_USER_DIR "${CMAKE_CURRENT_SOURCE_DIR}/../../../Zephyr_HPMicro/sdk_glue_user")
list(APPEND BOARD_ROOT "${SDK_GLUE_USER_DIR}")
list(APPEND SOC_ROOT "${SDK_GLUE_USER_DIR}")
list(APPEND DTS_ROOT "${SDK_GLUE_USER_DIR}")
list(APPEND DTS_ROOT "${SDK_GLUE_USER_DIR}/dts")

# 未指定 config 分组时，使用 board 名作为分组
if(NOT DEFINED BOARD_CFG)
  set(BOARD_CFG ${BOARD})
endif()

# 按 BOARD_CFG/BOARD 加载 board overlay（如 st/puzhong/stm32f4_disco.overlay）
file(GLOB OVERLAY_FILES ${CMAKE_CURRENT_SOURCE_DIR}/${PROJ_DIR}/boards/*/${BOARD_CFG}/${BOARD}.overlay)
if(OVERLAY_FILES)
  list(POP_FRONT OVERLAY_FILES DTC_OVERLAY_FILE)
endif()

# 按 BOARD_CFG/BOARD 加载板级 Kconfig 覆写
file(GLOB PRJ_CONF_FILES ${CMAKE_CURRENT_SOURCE_DIR}/${PROJ_DIR}/boards/*/${BOARD_CFG}/${BOARD}.conf)
if(PRJ_CONF_FILES)
  list(POP_FRONT PRJ_CONF_FILES EXTRA_CONF_FILE)
endif()

set(ZEPHYR_EXTRA_MODULES
  "${SDK_GLUE_DIR}"
  "${SDK_GLUE_DIR}/../modules/lib/CherryUSB"
  "${ZEPHYR_USER_DIR}/modules/usb"
  "${ZEPHYR_USER_DIR}/modules/cmsis"
)
set(ZEPHYR_SDK_INSTALL_DIR "${CMAKE_CURRENT_SOURCE_DIR}/../../zephyr-sdk-0.16.8" CACHE PATH "")

# 加载板级烧录脚本（flash.sh 等）
file(GLOB BOARD_CMAKE "${CMAKE_CURRENT_SOURCE_DIR}/${PROJ_DIR}/boards/*/${BOARD_CFG}/board.cmake")
if(BOARD_CMAKE)
  include(${BOARD_CMAKE})
endif()

find_package(Zephyr REQUIRED HINTS $ENV{ZEPHYR_BASE})
project(my_project)

# 系统入口
target_sources(app PRIVATE src/main.c)
target_include_directories(app PRIVATE src)
target_include_directories(app PRIVATE ${CMAKE_CURRENT_SOURCE_DIR}/init)
target_compile_options(app PRIVATE $<$<COMPILE_LANGUAGE:CXX>:-fno-threadsafe-statics>)

# CMSIS 头路径（core_cm4.h 等）
if(CONFIG_CPU_CORTEX_M)
  zephyr_include_directories("${ZEPHYR_BASE}/../modules/hal/cmsis/CMSIS/Core/Include")
  zephyr_include_directories("${ZEPHYR_USER_DIR}/modules/cmsis")
  zephyr_include_directories("${ZEPHYR_USER_DIR}/modules/usb")
  zephyr_compile_definitions(__PROGRAM_START)
endif()

# 应用模块（仅在 CONFIG_PRJ_TEST=y 时编译）
if(CONFIG_${CONFIG_SYM})
  add_subdirectory(drivers)
  add_subdirectory(algorithm)
  add_subdirectory(modules)
  add_subdirectory(topic)
  add_subdirectory(cmd)
  add_subdirectory(init)
  add_subdirectory(project)
endif()
```

## Kconfig
```
# 根 Kconfig — 项目入口门禁
# 定义 CONFIG_PRJ_TEST 开关，控制应用代码（project/）是否参与编译
# 子系统（CMSIS/zbus 等）的兼容性配置在此文件末尾
# 所有功能模块 Kconfig 由 project/thread/Kconfig 统一 rsource

config DEBUG_LOG
    bool "Enable Zephyr LOG output"
    default n
    select LOG
    select LOG_BACKEND_UART
    help
        Enable Zephyr logging system with UART backend.

if DEBUG_LOG

config LOG_DEFAULT_LEVEL
    int "Default log level (0=off, 1=err, 2=wrn, 3=inf, 4=dbg)"
    default 3
    range 0 4

endif

config PRJ_TEST
    bool "Test project"
    default n
    select DEBUG_LOG
    help
        测试项目
if PRJ_TEST
rsource "project/Kconfig"
endif


source "Kconfig.zephyr"
```

## prj.conf
```kconfig
# Common settings for all projects
CONFIG_CPP=y
CONFIG_STD_CPP17=y
CONFIG_STATIC_INIT_GNU=y
CONFIG_THREAD_NAME=y
CONFIG_SYS_CLOCK_TICKS_PER_SEC=2000
CONFIG_TICKLESS_KERNEL=n
CONFIG_PICOLIBC_IO_FLOAT=y
CONFIG_FPU=y
CONFIG_FPU_SHARING=y
CONFIG_ZBUS_PRIORITY_BOOST=n

# 项目级基础设施
CONFIG_HW_STACK_PROTECTION=y
CONFIG_SERIAL=y
CONFIG_CONSOLE=y
CONFIG_UART_CONSOLE=y
CONFIG_LOG_MODE_IMMEDIATE=y

CONFIG_PRJ_TEST=y
```

## src/main.c
```c
/**
 * @file main.c
 * @author qingyu
 * @brief 
 * @version 0.1
 * @date 2026-05-10
 * 
 * @copyright Copyright (c) 2026
 * 
 */

#include <zephyr/kernel.h>
#include "System_startup.h"

int main(void)
{
	System_Startup();

	while (1)
	{
		k_msleep(1000);
	}
}
```
